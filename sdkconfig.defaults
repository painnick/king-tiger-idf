## sdkconfig.defaults
```kconfig
# Bluetooth configuration
CONFIG_BT_ENABLED=y
CONFIG_BT_CONTROLLER_ONLY=y
CONFIG_BT_BTSTACK_ENABLED=y

# Bluetooth Controller
CONFIG_BT_CTRL_MODE_BTDM=y
CONFIG_BT_CTRL_BLE_MAX_CONN=3
CONFIG_BT_CTRL_BR_EDR_MAX_ACL_CONN=7
CONFIG_BT_CTRL_BR_EDR_MAX_SYNC_CONN=3

# Bluepad32 platform
CONFIG_BLUEPAD32_MAX_CONTROLLERS=4

# Partition Table
CONFIG_PARTITION_TABLE_CUSTOM=y
CONFIG_PARTITION_TABLE_CUSTOM_FILENAME="partitions.csv"
CONFIG_PARTITION_TABLE_FILENAME="partitions.csv"

# FreeRTOS
CONFIG_FREERTOS_HZ=1000

# Flash size
CONFIG_ESPTOOLPY_FLASHSIZE_4MB=y
CONFIG_ESPTOOLPY_FLASHSIZE="4MB"

# Stack size
CONFIG_ESP_MAIN_TASK_STACK_SIZE=8192
```
